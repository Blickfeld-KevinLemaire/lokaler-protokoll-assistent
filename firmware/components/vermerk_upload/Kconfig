## firmware/components/vermerk_upload/Kconfig
```kconfig
menu "VERMERK Upload"

    config VERMERK_KONFIG_TEST
        bool "Einstellungen zur Laufzeit setzen (nur fuer den QEMU-Test)"
        default n
        help
            Nur fuer test/qemu: Statt vermerk_konfig_standard.c (Werte aus server_config.h
            und wifi_credentials.h) wird vermerk_konfig_test.c gebaut: keine einkompilierten
            Ziele, dazu ein Zugang, mit dem der Test Adresse und Token zur Laufzeit setzt
            (vermerk_konfig_test.h). Auf den Geraeten nie einschalten.

endmenu
```

## firmware/esp32-s3/audio/sdkconfig.defaults
```kconfig
# VERMERK-Recorder auf Waveshare ESP32-S3-AUDIO-Board (ESP32-S3R8: 8 MB Octal-PSRAM, 16 MB Flash), ohne Bildschirm
CONFIG_ESPTOOLPY_FLASHMODE_QIO=y
CONFIG_ESPTOOLPY_FLASHFREQ_80M=y
CONFIG_ESPTOOLPY_FLASHSIZE_16MB=y
CONFIG_PARTITION_TABLE_CUSTOM=y
CONFIG_PARTITION_TABLE_CUSTOM_FILENAME="partitions.csv"

CONFIG_SPIRAM=y
CONFIG_SPIRAM_MODE_OCT=y
CONFIG_SPIRAM_SPEED_80M=y
CONFIG_SPIRAM_USE_CAPS_ALLOC=y
CONFIG_SPIRAM_TRY_ALLOCATE_WIFI_LWIP=y

CONFIG_ESP_DEFAULT_CPU_FREQ_MHZ_240=y
CONFIG_ESP32S3_DATA_CACHE_64KB=y
CONFIG_ESP32S3_DATA_CACHE_LINE_64B=y

CONFIG_ESP_CONSOLE_USB_SERIAL_JTAG=y
CONFIG_ESP_MAIN_TASK_STACK_SIZE=6144

# SD-Karte / Flash-Dateisystem
CONFIG_FATFS_LFN_STACK=y
CONFIG_FATFS_MAX_LFN=255
CONFIG_FATFS_API_ENCODING_ANSI_OEM=y

# I2S
CONFIG_I2S_ISR_IRAM_SAFE=y
CONFIG_I2S_SUPPRESS_DEPRECATE_WARN=y

# WLAN mit PSRAM
CONFIG_ESP_WIFI_STATIC_RX_BUFFER_NUM=10
CONFIG_ESP_WIFI_RX_BA_WIN=6
CONFIG_LWIP_TCP_OOSEQ_MAX_PBUFS=4

# groesserer TCP-Sendepuffer fuer schnelleren Upload
CONFIG_LWIP_TCP_SND_BUF_DEFAULT=23040
```
